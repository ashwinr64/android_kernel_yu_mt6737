## drivers/misc/mediatek/leds/Kconfig
```kconfig
config MTK_LEDS
	tristate "MediaTek LED Support"
	depends on LEDS_CLASS
	---help---
	  This selects the MediaTek(R) LEDs connected to MediaTek chips.
	  If you want to use MediaTek(R) LEDs support, say Y or M here.
	  If unsure, say N.
	  Mediatek LED module includes backlight, indicate LED, keypad LED, button LED etc.

config LIGHTNESS_MAPPING_VALUE
	int "LIGHTNESS_MAPPING_VALUE"
	default 255
 	---help---
	  Backlight brightness mapping value, from 0 to 255.

config BACKLIGHT_SUPPORT_LP8557
	bool "Support backlight lp8557 board"

config BACKLIGHT_SUPPORT_LM3697
	bool "LM3697(DW8832) Support"
	default n
 	---help---
	  charge pump driver for external backlight
	  
config MTK_LEDS_GPIO
	bool "MediaTek LED GPIO Support"

config PROJECT_V3951
	bool "PROJECT V3951 Support"

config PROJECT_V3953
	bool "PROJECT V3953 Support"
```

## drivers/misc/mediatek/magnetometer/akm09916-new/Kconfig
```kconfig
config MTK_AKM09916_NEW
	bool "AKM09916 for MediaTek package"
	default n
	help
	  It support different magnetometer sensor.
          If this option is set,
	  it will support
          AKMD09916 magnetometer.
```
